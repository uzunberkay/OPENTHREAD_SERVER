## CMakeLists.txt
```
cmake_minimum_required(VERSION 3.20.0)
find_package(Zephyr REQUIRED HINTS $ENV{ZEPHYR_BASE})

project(OPENTHREAD_SERVER)



target_include_directories(app PUBLIC ${CMAKE_CURRENT_SOURCE_DIR}/src/openthread_events)
target_include_directories(app PUBLIC ${CMAKE_CURRENT_SOURCE_DIR}/src/utils)




target_sources(app PRIVATE ${CMAKE_CURRENT_SOURCE_DIR}/src/openthread_events/openthread_events.c)
```

## prj.conf
```kconfig
CONFIG_SERIAL=y
CONFIG_LOG=y
CONFIG_GPIO=y


CONFIG_NET_L2_OPENTHREAD=y
CONFIG_NETWORKING=y

CONFIG_OPENTHREAD_FTD=y
CONFIG_OPENTHREAD_COAP=y

CONFIG_OPENTHREAD_NETWORK_NAME="TEST - NETWORK"
CONFIG_OPENTHREAD_PANID= 1441
CONFIG_OPENTHREAD_CHANNEL=14
CONFIG_OPENTHREAD_XPANID="aa:bb:b0:02:2a:bc:d0:23"
CONFIG_OPENTHREAD_NETWORKKEY="00:11:22:33:44:55:66:77:88:99:aa:bb:cc:dd:ee:ff"




CONFIG_OPENTHREAD_MANUAL_START=y    



CONFIG_SHELL=y
CONFIG_OPENTHREAD_SHELL=y
CONFIG_SHELL_ARGC_MAX=26
CONFIG_SHELL_CMD_BUFF_SIZE=416
```

## src/main.c
```c
#include <zephyr/kernel.h>

/**
 * @brief Uygulama giris noktasi.
 *
 * Zephyr tarafindan `SYS_INIT` ile kurulan altyapi ve OpenThread/CoAP
 * ilklendirmeleri calistiktan sonra ana thread burada calisir.
 * Ornek uygulamada ek bir is yapilmamaktadir.
 *
 * @return 0 basarili, diger durumlar icin hata kodu.
 */
int main(void)
{
        return 0;
}
```
